VERSION "1.0"

NS_ :

BS_:

BU_: ECU

BO_ 291 VehicleDynamics: 8 ECU
 SG_ LongAccel : 16|16@1- (0.001,0) [-32.768|32.767] "m/s2"  ECU
 SG_ VehicleSpeed : 0|16@1+ (0.01,0) [0|250] "km/h"  ECU

BO_ 512 ImuData_FD: 16 ECU
 SG_ SeqCounter : 64|8@1+ (1,0) [0|255] ""  ECU
 SG_ ImuTemp : 48|16@1- (0.01,0) [-327.68|327.67] "degC"  ECU
 SG_ RollAngle : 32|16@1- (0.01,0) [-327.68|327.67] "deg"  ECU
 SG_ LatAccel : 16|16@1- (0.001,0) [-32.768|32.767] "m/s2"  ECU
 SG_ YawRate : 0|16@1- (0.01,0) [-327.68|327.67] "deg/s"  ECU

BA_DEF_ BO_  "VFrameFormat" ENUM  "StandardCAN","ExtendedCAN","StandardCANFD","ExtendedCANFD";

BA_ "VFrameFormat" BO_ 291 0;
BA_ "VFrameFormat" BO_ 512 0;
